## Documentation/devicetree/bindings/gpio/gpio-74x164.txt
```
* Generic 8-bits shift register GPIO driver

Required properties:
- compatible: Should contain one of the following:
    "fairchild,74hc595"
    "nxp,74lvc594"
- reg : chip select number
- gpio-controller : Marks the device node as a gpio controller.
- #gpio-cells : Should be two.  The first cell is the pin number and
  the second cell is used to specify the gpio polarity:
      0 = active high
      1 = active low
- registers-number: Number of daisy-chained shift registers

Optional properties:
- enable-gpios: GPIO connected to the OE (Output Enable) pin.
- lines-initial-states: Bitmask that specifies the initial state of
  each line. When a bit is set to zero, the corresponding output line
  is initialized LOW. When a bit is set to one, the corresponding
  output line is initialized HIGH. In case this property is not
  defined, all lines will be initialized as LOW.

Example:

gpio5: gpio5@0 {
	compatible = "fairchild,74hc595";
	reg = <0>;
	gpio-controller;
	#gpio-cells = <2>;
	registers-number = <4>;
	spi-max-frequency = <100000>;
};
```

## Documentation/devicetree/bindings/phy/phy-ath79-usb.yaml
```yaml
# SPDX-License-Identifier: (GPL-2.0-only OR BSD-2-Clause)
%YAML 1.2
---
$id: http://devicetree.org/schemas/phy/qca,ar7100-usb-phy.yaml#
$schema: http://devicetree.org/meta-schemas/core.yaml#

title: Atheros AR71XX/9XXX USB PHY Device Tree Bindings

maintainers:
  - David Bauer <mail@david-bauer.net>

properties:
  "#phy-cells":
    const: 0

  compatible:
    const: qca,ar7100-usb-phy

  resets:
    maxItems: 2

  reset-names:
    items:
      - const: phy
      - const: suspend-override

required:
  - "#phy-cells"
  - compatible
  - resets
  - reset-names

additionalProperties: false

examples:
  - |
    usb-phy {
      compatible = "qca,ar7100-usb-phy";

      reset-names = "phy", "suspend-override";
      resets = <&rst 4>, <&rst 3>;

      #phy-cells = <0>;
    };

...
```
